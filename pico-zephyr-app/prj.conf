## CMakeLists.txt
```
#pico-zephyr-project
#-------------------------------------------------------------------------------
# Zephyr Example Application
#
# Copyright (c) 2021 Nordic Semiconductor ASA
# SPDX-License-Identifier: Apache-2.0
#-------------------------------------------------------------------------------
# NOTE: Please do not remove the #pico-zephyr-project header, it is used by
# the Raspberry Pi Pico VS Code extension to identify the project type.
#-------------------------------------------------------------------------------

cmake_minimum_required(VERSION 3.20.0)

find_package(Zephyr REQUIRED HINTS $ENV{ZEPHYR_BASE})
project(pico-zephyr-app LANGUAGES CXX)

FILE(GLOB app_sources 
    src/main.cpp
    src/AppContext.cpp
    src/thread/*.cpp
    src/peripheral/*.cpp
    # src/util/*.cpp
)
target_sources(app PRIVATE ${app_sources})
# target_sources(app PRIVATE src/main.cpp)
```

## prj.conf
```kconfig
CONFIG_GPIO=y

CONFIG_HWINFO=y

CONFIG_CPP=y
CONFIG_REQUIRES_FULL_LIBCPP=y


# Logging (global defaults)
CONFIG_LOG=y
CONFIG_LOG_PRINTK=y
CONFIG_LOG_DEFAULT_LEVEL=3
```

## boards/rpi_pico2_rp2350a_m33.overlay
```dts
#include <zephyr/dt-bindings/pinctrl/rpi-pico-rp2350a-pinctrl.h>

/ {
    aliases {
        led0 = &ext_led;
    };

    leds {
        compatible = "gpio-leds";
        ext_led: led_0 {
            gpios = <&gpio0 25 GPIO_ACTIVE_HIGH>;
            label = "on-board LED";
        };
    };
};
```

## boards/rpi_pico_rp2040_m0+.overlay
```dts
#include <zephyr/dt-bindings/pinctrl/rpi-pico-rp2040-pinctrl.h>

/ {
    aliases {
        led0 = &ext_led;
    };

    leds {
        compatible = "gpio-leds";
        ext_led: led_0 {
            gpios = <&gpio0 25 GPIO_ACTIVE_HIGH>;
            label = "on-board LED";
        };
    };
};
```

## src/main.cpp
```c
/* Copyright 2026 teamprof.net@gmail.com
 *
 * Permission is hereby granted, free of charge, to any person obtaining a copy
 * of this software and associated documentation files (the "Software"), to deal
 * in the Software without restriction, including without limitation the rights
 * to use, copy, modify, merge, publish, distribute, sublicense, and/or sell
 * copies of the Software, and to permit persons to whom the Software is
 * furnished to do so, subject to the following conditions:
 *
 * The above copyright notice and this permission notice shall be included in
 * all copies or substantial portions of the Software.
 *
 * THE SOFTWARE IS PROVIDED "AS IS", WITHOUT WARRANTY OF ANY KIND, EXPRESS OR
 * IMPLIED, INCLUDING BUT NOT LIMITED TO THE WARRANTIES OF MERCHANTABILITY,
 * FITNESS FOR A PARTICULAR PURPOSE AND NONINFRINGEMENT. IN NO EVENT SHALL THE
 * AUTHORS OR COPYRIGHT HOLDERS BE LIABLE FOR ANY CLAIM, DAMAGES OR OTHER
 * LIABILITY, WHETHER IN AN ACTION OF CONTRACT, TORT OR OTHERWISE, ARISING FROM,
 * OUT OF OR IN CONNECTION WITH THE SOFTWARE OR THE USE OR OTHER DEALINGS IN THE
 * SOFTWARE.
 */

// "rpi_pico",
// "-DDTC_OVERLAY_FILE=boards/rpi_pico2_rp2040_m0+.overlay",

// "rpi_pico2/rp2350a/m33",
// "-DDTC_OVERLAY_FILE=boards/rpi_pico2_rp2350a_m33.overlay",

#include <zephyr/kernel.h>
#include <zephyr/logging/log.h>

#include "AppContext.h"
#include "AppEvent.h"
#include "thread/QueueMain.h"

// LOG_MODULE_REGISTER(main, LOG_LEVEL_INF);
LOG_MODULE_REGISTER(main, LOG_LEVEL_DBG);

///////////////////////////////////////////////////////////////////////
int main(void)
{
    LOG_INF("...");
    auto ctx = get_app_context();
    if (ctx->threadApp)
    {
        ctx->threadApp->start(ctx);
    }
    else
    {
        LOG_ERR("No threadApp in context");
    }

    if (ctx->queueMain)
    {
        auto queueMain = static_cast<QueueMain *>(ctx->queueMain);
        queueMain->start(ctx);
        queueMain->postEvent(EventNull);
        queueMain->messageLoopForever();
    }
    else
    {
        LOG_ERR("No queueMain in context");
    }

    return 0;
}

// LOG_MODULE_REGISTER(main, CONFIG_LOG_DEFAULT_LEVEL);

// int main(void)
// {
//     printk("Hello World from Pico!\n");

//     while (1)
//     {
//         printk("Running on %s...\n", CONFIG_BOARD);

//         k_sleep(K_MSEC(1000));
//     }

//     return 0;
// }
```

## src/AppContext.cpp
```c
/* Copyright 2026 teamprof.net@gmail.com
 *
 * Permission is hereby granted, free of charge, to any person obtaining a copy
 * of this software and associated documentation files (the "Software"), to deal
 * in the Software without restriction, including without limitation the rights
 * to use, copy, modify, merge, publish, distribute, sublicense, and/or sell
 * copies of the Software, and to permit persons to whom the Software is
 * furnished to do so, subject to the following conditions:
 *
 * The above copyright notice and this permission notice shall be included in
 * all copies or substantial portions of the Software.
 *
 * THE SOFTWARE IS PROVIDED "AS IS", WITHOUT WARRANTY OF ANY KIND, EXPRESS OR
 * IMPLIED, INCLUDING BUT NOT LIMITED TO THE WARRANTIES OF MERCHANTABILITY,
 * FITNESS FOR A PARTICULAR PURPOSE AND NONINFRINGEMENT. IN NO EVENT SHALL THE
 * AUTHORS OR COPYRIGHT HOLDERS BE LIABLE FOR ANY CLAIM, DAMAGES OR OTHER
 * LIABILITY, WHETHER IN AN ACTION OF CONTRACT, TORT OR OTHERWISE, ARISING FROM,
 * OUT OF OR IN CONNECTION WITH THE SOFTWARE OR THE USE OR OTHER DEALINGS IN THE
 * SOFTWARE.
 */
#include "./AppContext.h"
#include "./thread/QueueMain.h"
#include "./thread/ThreadApp.h"

AppContext *get_app_context(void)
{
    static AppContext *_instance = NULL;
    if (!_instance)
    {
        static AppContext context = {
            .queueMain = QueueMain::getInstance(),
            .threadApp = ThreadApp::getInstance(),
            // .threadApp = NULL,
        };
        _instance = &context;
    }
    return _instance;
}
```

## src/AppContext.h
```c
/* Copyright 2026 teamprof.net@gmail.com
 *
 * Permission is hereby granted, free of charge, to any person obtaining a copy
 * of this software and associated documentation files (the "Software"), to deal
 * in the Software without restriction, including without limitation the rights
 * to use, copy, modify, merge, publish, distribute, sublicense, and/or sell
 * copies of the Software, and to permit persons to whom the Software is
 * furnished to do so, subject to the following conditions:
 *
 * The above copyright notice and this permission notice shall be included in
 * all copies or substantial portions of the Software.
 *
 * THE SOFTWARE IS PROVIDED "AS IS", WITHOUT WARRANTY OF ANY KIND, EXPRESS OR
 * IMPLIED, INCLUDING BUT NOT LIMITED TO THE WARRANTIES OF MERCHANTABILITY,
 * FITNESS FOR A PARTICULAR PURPOSE AND NONINFRINGEMENT. IN NO EVENT SHALL THE
 * AUTHORS OR COPYRIGHT HOLDERS BE LIABLE FOR ANY CLAIM, DAMAGES OR OTHER
 * LIABILITY, WHETHER IN AN ACTION OF CONTRACT, TORT OR OTHERWISE, ARISING FROM,
 * OUT OF OR IN CONNECTION WITH THE SOFTWARE OR THE USE OR OTHER DEALINGS IN THE
 * SOFTWARE.
 */
#pragma once
#include "./ArduProfApp.h"

namespace zephyros {
class MessageBus;
class MessageQueue;
class ThreadBase;
}; // namespace zephyros

typedef struct _AppContext {
    zephyros::MessageQueue *queueMain;
    zephyros::ThreadBase *threadApp;
} AppContext;

AppContext *get_app_context(void);
```

## src/AppEvent.h
```c
/* Copyright 2026 teamprof.net@gmail.com
 *
 * Permission is hereby granted, free of charge, to any person obtaining a copy
 * of this software and associated documentation files (the "Software"), to deal
 * in the Software without restriction, including without limitation the rights
 * to use, copy, modify, merge, publish, distribute, sublicense, and/or sell
 * copies of the Software, and to permit persons to whom the Software is
 * furnished to do so, subject to the following conditions:
 *
 * The above copyright notice and this permission notice shall be included in
 * all copies or substantial portions of the Software.
 *
 * THE SOFTWARE IS PROVIDED "AS IS", WITHOUT WARRANTY OF ANY KIND, EXPRESS OR
 * IMPLIED, INCLUDING BUT NOT LIMITED TO THE WARRANTIES OF MERCHANTABILITY,
 * FITNESS FOR A PARTICULAR PURPOSE AND NONINFRINGEMENT. IN NO EVENT SHALL THE
 * AUTHORS OR COPYRIGHT HOLDERS BE LIABLE FOR ANY CLAIM, DAMAGES OR OTHER
 * LIABILITY, WHETHER IN AN ACTION OF CONTRACT, TORT OR OTHERWISE, ARISING FROM,
 * OUT OF OR IN CONNECTION WITH THE SOFTWARE OR THE USE OR OTHER DEALINGS IN THE
 * SOFTWARE.
 */
#pragma once
#include <stdint.h>

enum AppEvent {
    EventNull = 0,

    EventSystem, // iParam=<SystemTriggerSource>

    // EventBle, // iParam=<BleTriggerSource>
};

enum SystemTriggerSource {
    SysNull = 0,
    SysSoftwareTimer, // lParam=xTimer:uint32_t
    SysLowBattery,

    SysUartRxRdy,      // lParam=number of bytes received in this chunk
    SysUartRxOverflow, // ring buffer was too full, some data may be lost

    // SysBleAdvertize,
    // SysBleConnected,    // uParam=err
    // SysBleDisconnected, // uParam=reason
    // SysBleCCChanged,    // uParam=reason
    // SysBleOnRead,       // uParam=size, lParam=content value in uint32_t format
    // SysBleOnWrite,      // uParam=size, lParam=content value in uint32_t format

    SysEthUp,
    SysEthDown,
    SysEthIpv4Add,
};

// enum BleTriggerSource {
//     BleNull = 0,
//     BleConnected,    // uParam=err
//     BleDisconnected, // uParam=reason
//     BleOnRead,       // uParam=size, lParam=content value in uint32_t format
//     BleOnWrite,      // uParam=size, lParam=content value in uint32_t format
// };
```

## src/ArduProfApp.h
```c
/* Copyright 2026 teamprof.net@gmail.com
 *
 * Permission is hereby granted, free of charge, to any person obtaining a copy
 * of this software and associated documentation files (the "Software"), to deal
 * in the Software without restriction, including without limitation the rights
 * to use, copy, modify, merge, publish, distribute, sublicense, and/or sell
 * copies of the Software, and to permit persons to whom the Software is
 * furnished to do so, subject to the following conditions:
 *
 * The above copyright notice and this permission notice shall be included in
 * all copies or substantial portions of the Software.
 *
 * THE SOFTWARE IS PROVIDED "AS IS", WITHOUT WARRANTY OF ANY KIND, EXPRESS OR
 * IMPLIED, INCLUDING BUT NOT LIMITED TO THE WARRANTIES OF MERCHANTABILITY,
 * FITNESS FOR A PARTICULAR PURPOSE AND NONINFRINGEMENT. IN NO EVENT SHALL THE
 * AUTHORS OR COPYRIGHT HOLDERS BE LIABLE FOR ANY CLAIM, DAMAGES OR OTHER
 * LIABILITY, WHETHER IN AN ACTION OF CONTRACT, TORT OR OTHERWISE, ARISING FROM,
 * OUT OF OR IN CONNECTION WITH THE SOFTWARE OR THE USE OR OTHER DEALINGS IN THE
 * SOFTWARE.
 */
#pragma once

#undef ARDUPROF_FREERTOS
#undef ARDUPROF_ZEPHYR
#undef ARDUPROF_MBED

///////////////////////////////////////////////////////////////////////////////
// For ESP32/ESP32C3/ESP32S3
// note: USB CDC On Boot: :Enabled"
///////////////////////////////////////////////////////////////////////////////
// #define ARDUPROF_FREERTOS
// #include <ArduProf.h>

///////////////////////////////////////////////////////////////////////////////
// For Pi Pico2 board (FreeRTOS)
// note: Operation System: "FreeRTOS SMP"
//       USB Stack: "Pico SDK"
///////////////////////////////////////////////////////////////////////////////
// #define ARDUPROF_FREERTOS
// #include <ArduProf.h>

///////////////////////////////////////////////////////////////////////////////
// For Pi Pico Mbed
///////////////////////////////////////////////////////////////////////////////
// #define ARDUPROF_MBED
// #include <ArduProf.h>

///////////////////////////////////////////////////////////////////////////////
// For Zephyr
///////////////////////////////////////////////////////////////////////////////
#define ARDUPROF_ZEPHYR
#include "../lib/arduprof/src/ArduProf.h"
```
