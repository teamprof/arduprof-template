## nrf-zephyr-app/sample.yaml
```yaml
sample:
  name: ArduProf template nRF Sample
tests:
  sample.basic.blinky:
    tags:
      - ArduProf
      - LED
    filter: 
    depends_on: 
    harness: led
```

## pico-nuttx-app/src/app/Kconfig
```kconfig
config ARDUPROF_APP
	tristate "ArduProf App"
	default y
	---help---
		Enable the ArduProf application.

if ARDUPROF_APP

config ARDUPROF_APP_PROGNAME
	string "Program name"
	default "arduprof"

config ARDUPROF_APP_PRIORITY
	int "Task priority"
	default 100

config ARDUPROF_APP_STACKSIZE
	int "Stack size"
	default DEFAULT_TASK_STACKSIZE

endif
```
