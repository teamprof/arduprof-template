// #include <zephyr/dt-bindings/pinctrl/nrf-pinctrl.h>
// #include <nordic/nrf52840_qiaa.dtsi>


/ {
	model = "ProMicro nRF52840 UF2";
	compatible = "nordic,nrf52840-dk-nrf52840";

    aliases {
        ledusr = &led0;

    };
};

